## main/Kconfig
~~~~kconfig
menu "OWL"

config OWL_DEV
    bool "Development mode"
    default n
    help
      If enabled, will preconfigure WiFi SSID and password according to `main/secrets.inc`:
      ```
      // Example file structure
      ssid = "ExampleSSID";
      pass = "ExamplePASS";
      ```
      If disabled, the default credentials will be empty.

config OWL_WIFI_SSID
    string "WiFi SSID"
    default ""
    help
      SSID to use when connecting to WiFi network in STA mode

config OWL_WIFI_PASS
    string "WiFi password"
    default ""
    help
      Password to use when connecting to WiFi network in STA mode

config OWL_SOFTAP_SSID
    string "SoftAP SSID"
    default "OWL"
    help
      SSID for SoftAP mode

config OWL_SOFTAP_PASS
    string "SoftAP password"
    default "FR4#1UL4"
    help
      Password for SoftAP mode

config OWL_SOFTAP_CH
    int "SoftAP WiFi channel"
    default 6
    help
      WiFi channel for SoftAP mode

config OWL_SOFTAP_MAX_CONN
    int "SoftAP max connections"
    default 4
    help
      Max number of connected stations for SoftAP mode    

config OWL_LED_GPIO
    int "LED GPIO"
    default 2
    help
      LED GPIO number

config OWL_BUTTON_GPIO
    int "Button GPIO"
    default 36
    help
      Button GPIO number

config OWL_ONEWIRE_BUS_GPIO
    int "OneWire bus GPIO"
    default 23
    help
      OneWire bus GPIO number

config OWL_USE_LCD
    bool "Use LCD"
    default n
    help
        Use LCD display (DFRobot LCD1802)

config OWL_USE_EPAPER
    bool "Use EPAPER"
    default n
    help
        Use EPAPER display (Waveshare 12955)

endmenu
~~~~
